## arch/arm/mach-rockchip/rk3576/Kconfig
```kconfig
if ROCKCHIP_RK3576

config TARGET_FLIPPER_ONE_RK3576
	bool "Flipper One"
	help
	  Flipper One is a handheld networking multitool for enthusiasts
	  using the Rockchip RK3576.

config TARGET_ROC_PC_RK3576
	bool "Firefly ROC-RK3576-PC"
	help
	  ROC-RK3576-PC is a single board computer from Firefly
	  using the Rockchip RK3576.

config ROCKCHIP_BOOT_MODE_REG
	default 0x26024040

config ROCKCHIP_STIMER_BASE
	default 0x27400000

config SYS_SOC
	default "rk3576"

source board/firefly/roc-pc-rk3576/Kconfig

config SYS_CONFIG_NAME
	default "flipper-one-rk3576" if TARGET_FLIPPER_ONE_RK3576
	default "rk3576_common"

endif
```

## board/flipper/flipper-one/Kconfig
```kconfig
if TARGET_FLIPPER_ONE_RK3576

config SYS_BOARD
	default "flipper-one"

config SYS_VENDOR
	default "flipper"

config SYS_CONFIG_NAME
	default "flipper-one-rk3576"

config BOARD_SPECIFIC_OPTIONS
	def_bool y
	select ADC
	select SPL_ADC

endif
```

## configs/flipper-one-rk3576_defconfig
```kconfig
CONFIG_ARM=y
CONFIG_SKIP_LOWLEVEL_INIT=y
CONFIG_COUNTER_FREQUENCY=24000000
CONFIG_ARCH_ROCKCHIP=y
CONFIG_SPL_GPIO=y
CONFIG_DEFAULT_DEVICE_TREE="rockchip/rk3576-flipper-one-rev-f0b0c1"
CONFIG_ROCKCHIP_RK3576=y
CONFIG_TARGET_FLIPPER_ONE_RK3576=y
CONFIG_SYS_LOAD_ADDR=0x40c00800
CONFIG_DEBUG_UART_BASE=0x2AD40000
CONFIG_DEBUG_UART_CLOCK=24000000
CONFIG_PCI=y
CONFIG_DEBUG_UART=y
CONFIG_BOOTDELAY=1
CONFIG_AUTOBOOT_KEYED=y
CONFIG_AUTOBOOT_PROMPT="Autoboot in %d seconds, to stop use 's' key\n"
CONFIG_AUTOBOOT_STOP_STR="s"
CONFIG_BOOTCOMMAND="bootflow scan -l; if bootflow menu; then cls; bootflow boot; else run bootcmd; fi"
CONFIG_DEFAULT_FDT_FILE="rockchip/rk3576-flipper-one-rev-f0b0c1.dtb"
# CONFIG_DISPLAY_CPUINFO is not set
CONFIG_CYCLIC_MAX_CPU_TIME_US=50000
CONFIG_SPL_MAX_SIZE=0x40000
# CONFIG_SPL_RAW_IMAGE_SUPPORT is not set
CONFIG_SPL_DM_RESET=y
CONFIG_SPL_UFS_SUPPORT=y
CONFIG_CMD_TCPM=y
CONFIG_CMD_MEMINFO=y
CONFIG_CMD_MEMINFO_MAP=y
CONFIG_CMD_ADC=y
CONFIG_CMD_GPIO=y
CONFIG_CMD_GPT=y
CONFIG_CMD_I2C=y
CONFIG_CMD_MISC=y
CONFIG_CMD_MMC=y
CONFIG_CMD_UFS=y
CONFIG_CMD_USB=y
CONFIG_CMD_ROCKUSB=y
CONFIG_CMD_USB_MASS_STORAGE=y
# CONFIG_CMD_SETEXPR is not set
CONFIG_CMD_RNG=y
CONFIG_CMD_REGULATOR=y
# CONFIG_SPL_DOS_PARTITION is not set
CONFIG_OF_SPL_REMOVE_PROPS="clock-names interrupt-parent assigned-clocks assigned-clock-rates assigned-clock-parents"
CONFIG_BUTTON=y
CONFIG_BUTTON_GPIO=y
# CONFIG_USB_FUNCTION_FASTBOOT is not set
CONFIG_ROCKCHIP_GPIO=y
CONFIG_DM_PCA953X=y
CONFIG_SYS_I2C_ROCKCHIP=y
CONFIG_DM_KEYBOARD=y
CONFIG_FLIPPER_ONE_BTNS=y
CONFIG_SUPPORT_EMMC_RPMB=y
CONFIG_MMC_DW=y
CONFIG_MMC_DW_ROCKCHIP=y
CONFIG_MMC_SDHCI=y
CONFIG_MMC_SDHCI_SDMA=y
CONFIG_MMC_SDHCI_ROCKCHIP=y
CONFIG_PHY_ROCKCHIP_INNO_USB2=y
CONFIG_PHY_ROCKCHIP_NANENG_COMBOPHY=y
CONFIG_PHY_ROCKCHIP_USBDP=y
CONFIG_DM_PMIC=y
CONFIG_PMIC_RK8XX=y
CONFIG_REGULATOR_RK8XX=y
CONFIG_SCSI=y
CONFIG_BAUDRATE=1500000
CONFIG_DEBUG_UART_SHIFT=2
CONFIG_SYS_NS16550_MEM32=y
CONFIG_ROCKCHIP_SPI=y
CONFIG_SYSRESET_PSCI=y
CONFIG_USB=y
CONFIG_USB_XHCI_HCD=y
CONFIG_USB_DWC3=y
CONFIG_USB_DWC3_GENERIC=y
CONFIG_TYPEC_TCPM=y
CONFIG_TYPEC_FUSB302=y
CONFIG_USB_ONBOARD_HUB=y
CONFIG_USB_GADGET=y
CONFIG_USB_GADGET_DOWNLOAD=y
CONFIG_USB_FUNCTION_ROCKUSB=y
CONFIG_UFS=y
CONFIG_UFS_ROCKCHIP=y
CONFIG_VIDEO=y
CONFIG_VIDEO_FONT_6X8=y
# CONFIG_VIDEO_FONT_8X16 is not set
# CONFIG_BACKLIGHT is not set
# CONFIG_VIDEO_BPP16 is not set
# CONFIG_VIDEO_BPP32 is not set
# CONFIG_SYS_WHITE_ON_BLACK is not set
# CONFIG_PANEL is not set
CONFIG_VIDEO_FLIPPER_ONE=y
CONFIG_ERRNO_STR=y
```
